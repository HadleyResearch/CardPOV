	org 0800h
	#define povsegs1 	54			;Constant for number of segments in string 1
	#define	povsegs2	49			;Constang for number of segments in string 2
	#define	povsegs3	64 
	
pov_table ;table containing locations of pov character strings and lengths
	de	0x03
	de	0x36,0x00,0x08,0x0C	;string 1 pov length and location
	de	0x31,0x00,0x08,0x42	;string 2 pov length and location
	de	0x40,0x00,0x08,0x82	;string 3 pov length and location	
end_table

pov_string1 ;pov character data (string 1)
	de	0x00,0x00,0x00,0x00,0x00		;Buffer
	de	0x00,0x00,0x00,0x00,0x00		;Buffer
  	de 	0x79,0x49,0x49,0x4F,0x0
 	de 	0x10,0x3F,0x10,0x0
 	de 	0x1F,0x15,0x15,0x1D,0x0
 	de 	0x3F,0x48,0x40,0x0
 	de 	0xF,0x11,0x12,0x1F,0x0
 	de 	0x1F,0x8,0x10,0x1F,0x0
 	de 	0x5F,0x0
 	de 	0x1F,0x15,0x15,0x1D
 	de	0x00,0x00,0x00,0x00,0x00		;Buffer
	de	0x00,0x00,0x00,0x00,0x00		;Buffer
end_string1

pov_string2	;pov character data (string 2)
	de	0x00,0x00,0x00,0x00,0x00		;Buffer
	de	0x00,0x00,0x00,0x00,0x00		;Buffer
	de 	0x7F,0x8,0x8,0x7F,0x0
 	de 	0x3F,0x48,0x48,0x3F,0x0
 	de 	0x7F,0x41,0x41,0x3E,0x0
 	de 	0x7F,0x1,0x1,0x0
	de 	0x7F,0x49,0x49,0x41,0x0
 	de 	0x70,0x8,0x7,0x8,0x70
	de	0x00,0x00,0x00,0x00,0x00		;Buffer
	de	0x00,0x00,0x00,0x00,0x00		;Buffer
end_string2

pov_string3 ;pov character data (string 3)
	de	0x00,0x00,0x00,0x00,0x00		;Buffer
	de	0x00,0x00,0x00,0x00,0x00		;Buffer
	de 	0x7F,0x8,0x8,0x14,0x63,0x0
 	de 	0x7F,0x49,0x49,0x41,0x0
 	de 	0x7F,0x10,0x8,0x4,0x7F,0x0
 	de 	0x40,0x40,0x7F,0x40,0x40,0x0
 	de 	0x7F,0x1,0x1,0x7F,0x0
 	de 	0x7F,0x41,0x41,0x41,0x0
 	de 	0x7F,0x8,0x8,0x14,0x63,0x0
 	de 	0x70,0x8,0x7,0x8,0x70
	de	0x00,0x00,0x00,0x00,0x00		;Buffer
	de	0x00,0x00,0x00,0x00,0x00		;Buffer
end_string3